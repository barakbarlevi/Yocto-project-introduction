## build-mp1/conf/bblayers.conf
```bitbake
# POKY_BBLAYERS_CONF_VERSION is increased each time build/conf/bblayers.conf
# changes incompatibly
POKY_BBLAYERS_CONF_VERSION = "2"

BBPATH = "${TOPDIR}"
BBFILES ?= ""

BBLAYERS ?= " \
  /home/barak/Projects/yocto/poky/meta \
  /home/barak/Projects/yocto/poky/meta-poky \
  /home/barak/Projects/yocto/poky/meta-yocto-bsp \
  /home/barak/Projects/yocto/meta-openembedded/meta-oe \
  /home/barak/Projects/yocto/meta-openembedded/meta-python \
  /home/barak/Projects/yocto/meta-st-stm32mp  \
  /home/barak/Projects/yocto/meta-custom \
  "
```
